## conf/layer.conf
```bitbake
# We have a conf and classes directory, add to BBPATH
BBPATH .= ":${LAYERDIR}"

# We have recipes-* directories, add to BBFILES
BBFILES += "${LAYERDIR}/recipes-*/*/*.bb \
            ${LAYERDIR}/recipes-*/*/*.bbappend"

BBFILE_COLLECTIONS += "intel"
BBFILE_PATTERN_intel := "^${LAYERDIR}/"
BBFILE_PRIORITY_intel = "5"

# Additional license directories.
CUSTOM_LICENSES_PATH = "${LAYERDIR}/custom-licenses"
LICENSE_PATH += "${CUSTOM_LICENSES_PATH}"

LAYERDEPENDS_intel = "core"
LAYERRECOMMENDS_intel = "dpdk"

# This should only be incremented on significant changes that will
# cause compatibility issues with other layers
LAYERVERSION_intel = "5"
LAYERSERIES_COMPAT_intel = "whinlatter"

BBFILES_DYNAMIC += " \
    openembedded-layer:${LAYERDIR}/dynamic-layers/openembedded-layer/*/*/*.bb \
    openembedded-layer:${LAYERDIR}/dynamic-layers/openembedded-layer/*/*/*.bbappend \
    meta-python:${LAYERDIR}/dynamic-layers/meta-python/*/*/*.bb \
    meta-python:${LAYERDIR}/dynamic-layers/meta-python/*/*/*.bbappend \
"

require ${LAYERDIR}/conf/include/maintainers.inc

# Use the libva from OE-Core when layer is included but no MACHINE
# from meta-intel is being used.
PREFERRED_PROVIDER_libva ?= "libva"
PREFERRED_PROVIDER_libva-native ?= "libva-native"
PREFERRED_PROVIDER_nativesdk-libva ?= "nativesdk-libva"

PREFERRED_PROVIDER_libva-utils ?= "libva-utils"
PREFERRED_PROVIDER_libva-utils-native ?= "libva-utils-native"
PREFERRED_PROVIDER_nativesdk-libva-utils ?= "nativesdk-libva-utils"

addpylib ${LAYERDIR}/lib oeqa
```

## conf/machine/include/intel-common-pkgarch.inc
```bitbake
INTEL_COMMON_PACKAGE_ARCH ?= "${TUNE_PKGARCH}-intel-common"
PACKAGE_ARCH:pn-linux-intel = "${INTEL_COMMON_PACKAGE_ARCH}"
PACKAGE_ARCH:pn-linux-intel-rt = "${INTEL_COMMON_PACKAGE_ARCH}"
PACKAGE_ARCH:pn-linux-intel-tiny = "${INTEL_COMMON_PACKAGE_ARCH}"
PACKAGE_ARCH:pn-linux-intel-dev = "${INTEL_COMMON_PACKAGE_ARCH}"
PACKAGE_ARCH:pn-linux-yocto = "${INTEL_COMMON_PACKAGE_ARCH}"
PACKAGE_ARCH:pn-linux-yocto-rt = "${INTEL_COMMON_PACKAGE_ARCH}"
PACKAGE_ARCH:pn-linux-yocto-tiny = "${INTEL_COMMON_PACKAGE_ARCH}"
PACKAGE_ARCH:pn-linux-yocto-dev = "${INTEL_COMMON_PACKAGE_ARCH}"
PACKAGE_ARCH:pn-intel-microcode = "${INTEL_COMMON_PACKAGE_ARCH}"
PACKAGE_ARCH:pn-backport-iwlwifi = "${INTEL_COMMON_PACKAGE_ARCH}"
PACKAGE_ARCH:pn-ixgbe = "${INTEL_COMMON_PACKAGE_ARCH}"
PACKAGE_ARCH:pn-ixgbevf = "${INTEL_COMMON_PACKAGE_ARCH}"
PACKAGE_EXTRA_ARCHS:append = " ${INTEL_COMMON_PACKAGE_ARCH}"
MACHINEOVERRIDES =. "${INTEL_COMMON_PACKAGE_ARCH}:"
```

## conf/machine/include/intel-core2-32-common.inc
```bitbake
#
# Common configuration for all MACHINEs of the intel-core2 type
#

DEFAULTTUNE ?= "core2-32"
require conf/machine/include/x86/tune-core2.inc
require conf/machine/include/x86/x86-base.inc
```

## conf/machine/include/intel-corei7-64-common.inc
```bitbake
#
# Common configuration for all MACHINES of the intel-corei7-64 type
#

DEFAULTTUNE ?= "corei7-64"
require conf/machine/include/x86/tune-corei7.inc
require conf/machine/include/x86/x86-base.inc
```

## conf/machine/include/meta-intel.inc
```bitbake
#
# BSP variables and settings specific to the meta-intel layer.
# You must include the meta-intel layer in your bblayers.conf
# to use them.
#

PREFERRED_PROVIDER_virtual/kernel ?= "linux-intel"
PREFERRED_PROVIDER_virtual/kernel:poky-tiny ?= "linux-intel"

PREFERRED_VERSION_linux-intel ?= "6.6%"
PREFERRED_VERSION_linux-intel-rt ?= "6.6%"
PREFERRED_VERSION_linux-intel:poky-altcfg ?= "6.8%"

# Need to point to latest version of libva needed for media components
PREFERRED_PROVIDER_libva = "libva-intel"
PREFERRED_PROVIDER_libva-native = "libva-intel-native"
PREFERRED_PROVIDER_nativesdk-libva = "nativesdk-libva-intel"

PREFERRED_PROVIDER_libva-utils = "libva-intel-utils"
PREFERRED_PROVIDER_libva-utils-native = "libva-intel-utils-native"
PREFERRED_PROVIDER_nativesdk-libva-utils = "nativesdk-libva-intel-utils"

LLVM_MAJOR_VERSION = "${@d.getVar('LLVMVERSION').split('.')[0]}"
PREFERRED_VERSION_opencl-clang ?= "${@bb.utils.contains('LLVM_MAJOR_VERSION', '14', '14.0.0', '15.0.0', d)}"
PREFERRED_VERSION_opencl-clang-native ?= "${@bb.utils.contains('LLVM_MAJOR_VERSION', '14', '14.0.0', '15.0.0', d)}"

XSERVER_X86_ASPEED_AST = "xf86-video-ast \
           "

# include the user space intel microcode loading support in the generated images.
MACHINE_ESSENTIAL_EXTRA_RDEPENDS:append = "${@bb.utils.contains('MACHINE_FEATURES', 'intel-ucode', ' intel-microcode', '', d)}"

# recommended extra packages common to all intel machines
MACHINE_EXTRA_RRECOMMENDS:append = " kernel-modules linux-firmware"
MACHINE_ESSENTIAL_EXTRA_RRECOMMENDS:append = " kernel-module-i915 linux-firmware-i915 kernel-module-igc kernel-module-r8152"

# for the early boot time kernel microcode loading support,
# merge the microcode data in the final initrd image.
INITRD_LIVE:prepend = "${@bb.utils.contains('MACHINE_FEATURES', 'intel-ucode', '${DEPLOY_DIR_IMAGE}/microcode.cpio ', '', d)}"

DISK_SIGNATURE_UUID ??= "deadbeef-dead-beef-dead-beefdeadbeef"

EFI_PROVIDER ?= "systemd-boot"
EFI_PROVIDER:x86-x32 = "grub-efi"

# Add general MACHINEOVERRIDE for meta-intel
MACHINEOVERRIDES =. "intel-x86-common:"

# Definition of (more or less) suitable virtual machines.
require conf/machine/include/qemuboot-intel.inc

# Ensure that the extra tools needed by qemu are built when building images
# and tweak machine definition to make the result more usable under qemu.
require conf/machine/include/qemu-intel.inc
```

## conf/machine/include/qemuboot-intel.inc
```bitbake
# For runqemu
IMAGE_CLASSES += "qemuboot"
QB_SYSTEM_NAME:intel-core2-32 = "qemu-system-i386"
QB_CPU:intel-core2-32 = "-cpu coreduo"
QB_CPU_KVM:intel-core2-32 = "-cpu kvm32"

QB_SYSTEM_NAME:intel-corei7-64 = "qemu-system-x86_64"
QB_CPU:intel-corei7-64 = "-cpu Nehalem"
QB_CPU_KVM:intel-corei7-64 = "-cpu kvm64"

QB_SYSTEM_NAME:intel-skylake-64 = "qemu-system-x86_64"
QB_CPU:intel-skylake-64 = "-cpu Skylake-Client"
QB_CPU_KVM:intel-skylake-64 = "-cpu Skylake-Client"

QB_AUDIO_DRV = "alsa"
QB_AUDIO_OPT = "-device AC97"
QB_KERNEL_CMDLINE_APPEND = " oprofile.timer=1"
# Add the 'virtio-rng-pci' device otherwise the guest may run out of entropy
QB_OPT_APPEND = " -usb -usbdevice tablet -device virtio-rng-pci"
```

## conf/machine/include/tune-skylake.inc
```bitbake
# Settings for the GCC(1) cpu-type "skylake":
#
#     Intel Skylake CPU with 64-bit extensions, MMX, SSE, SSE2, SSE3, SSSE3, SSE4.1,
#     SSE4.2, AVX, AVX2 and POPCNT instruction set support.
#
# This tune is recommended for Intel Skylake CPU (and beyond).
#
DEFAULTTUNE ?= "skylake-64"

# Include the previous tune to pull in PACKAGE_EXTRA_ARCHS
require conf/machine/include/tune-corei7.inc

# Extra tune features
TUNEVALID[skylake] = "Enable skylake specific processor optimizations"
TUNE_CCARGS .= "${@bb.utils.contains('TUNE_FEATURES', 'skylake', ' -march=skylake ${SKYLAKE_TUNE} -mfpmath=sse', '', d)}"

# Extra tune selections

AVAILTUNES += "skylake-64"
TUNE_FEATURES_tune-skylake-64 = "${TUNE_FEATURES_tune-x86-64} skylake"
BASE_LIB_tune-skylake-64 = "lib64"
TUNE_PKGARCH_tune-skylake-64 = "skylake-64"
PACKAGE_EXTRA_ARCHS_tune-skylake-64 = "${PACKAGE_EXTRA_ARCHS_tune-core2-64} skylake-64"
QEMU_EXTRAOPTIONS_skylake-64 = " -cpu Skylake-Client"


# Disable QEMU usermode by default (get avx2)
MACHINE_FEATURES_remove = "qemu-usermode"

# If qemu-usermode is enabled, we have to disable avx2 ISA extensions, but we can keep mtune as skylake vs generic
SKYLAKE_TUNE .= "${@bb.utils.contains('MACHINE_FEATURES', 'qemu-usermode', ' -mtune=skylake ${QEMU_UNAVAILABLE_ISA}', '-mtune=generic -mavx2', d)}"

QEMU_UNAVAILABLE_ISA = " \
-mno-avx \
-mno-avx2 \
-mno-avx512f \
-mno-avx512er \
-mno-avx512cd \
-mno-avx512pf \
-mno-avx512dq \
-mno-avx512bw \
-mno-avx512vl \
-mno-avx512ifma \
-mno-avx512vbmi \
-mno-avx512vbmi2 \
-mno-avx512vnni \
-mno-avx512bitalg \
"
```

## conf/machine/intel-core2-32.conf
```bitbake
#@TYPE: Machine
#@NAME: intel-core2-32

#@DESCRIPTION: Machine configuration for 32 bit Intel Core 2 CPU (and later) with MMX, SSE, SSE2, SSE3, and SSSE3 instruction set support. Supports a moderately wide range of drivers that should boot and be usable on "typical" hardware.

require conf/machine/include/meta-intel.inc
require conf/machine/include/intel-core2-32-common.inc
require conf/machine/include/intel-common-pkgarch.inc

MACHINE_FEATURES += "pcbios efi"
MACHINE_FEATURES += "wifi 3g nfc"
MACHINE_FEATURES += "intel-ucode"

MACHINE_HWCODECS ?= "intel-vaapi-driver gstreamer1.0-vaapi"

XSERVER ?= "${XSERVER_X86_BASE} \
            ${XSERVER_X86_EXT} \
            ${XSERVER_X86_FBDEV} \
            ${XSERVER_X86_I915} \
            ${XSERVER_X86_I965} \
            ${XSERVER_X86_MODESETTING} \
            ${XSERVER_X86_VESA} \
            ${XSERVER_X86_ASPEED_AST} \
           "

SYSLINUX_OPTS = "serial 0 115200"
SERIAL_CONSOLES ?= "115200;ttyS0 115200;ttyS1 115200;ttyPCH0"
APPEND += "rootwait console=ttyS0,115200 console=ttyPCH0,115200 console=tty0"

IMAGE_FSTYPES += "wic"
WKS_FILE ?= "${@bb.utils.contains_any("EFI_PROVIDER", "systemd-boot", "systemd-bootdisk-microcode.wks.in", "grub-bootdisk-microcode.wks.in", d)}"
WKS_FILE_DEPENDS:append = " intel-microcode"
```

## conf/machine/intel-skylake-64.conf
```bitbake
#@TYPE: Machine
#@NAME: intel-skylake-64

#@DESCRIPTION: Machine configuration for 64 bit Intel Skylake CPU (and later) with MMX, SSE, SSE2, SSE3, SSE4.1, SSE4.2, AVX, and AVX2 instruction set support. Supports a moderately wide range of drivers that should boot and be usable on "typical" hardware.

require conf/machine/include/meta-intel.inc
require conf/machine/include/x86-base.inc
require conf/machine/include/tune-skylake.inc
require conf/machine/include/intel-common-pkgarch.inc

MACHINE_FEATURES += "efi"
MACHINE_FEATURES += "wifi 3g nfc"
MACHINE_FEATURES += "intel-ucode"

MACHINE_HWCODECS ?= "intel-media-driver intel-mediasdk intel-vaapi-driver gstreamer1.0-vaapi"

COMPATIBLE_MACHINE_pn-dpdk = "intel-skylake-64"

XSERVER ?= "${XSERVER_X86_BASE} \
            ${XSERVER_X86_EXT} \
            ${XSERVER_X86_FBDEV} \
            ${XSERVER_X86_I915} \
            ${XSERVER_X86_I965} \
            ${XSERVER_X86_MODESETTING} \
            ${XSERVER_X86_VESA} \
            ${XSERVER_X86_ASPEED_AST} \
           "

SYSLINUX_OPTS = "serial 0 115200"
SERIAL_CONSOLES = "115200;ttyS0 115200;ttyS1 115200;ttyS2"
APPEND += "rootwait console=ttyS0,115200 console=tty0"

IMAGE_FSTYPES += "wic"
WKS_FILE ?= "${@bb.utils.contains_any("EFI_PROVIDER", "systemd-boot", "systemd-bootdisk-microcode.wks.in", "grub-bootdisk-microcode.wks.in", d)}"
WKS_FILE_DEPENDS_append = " intel-microcode"
```

## meta-cedartrail/conf/machine/cedartrail-nopvr.conf
```bitbake
#@TYPE: Machine
#@NAME: Cedartrail-nopvr 

#@DESCRIPTION: Machine configuration for Cedartrail systems
# i.e. Cedarview (N2600, N2800 and D2700) processor +
# Tiger Point (Intel® NM10 Express) Chipset

include conf/machine/include/tune-atom.inc

MACHINE_FEATURES = "kernel26 screen keyboard pci usbhost ext2 ext3 x86 \
                    acpi serial usbgadget alsa"

KERNEL_IMAGETYPE = "bzImage"

PREFERRED_PROVIDER_virtual/kernel ?= "linux-yocto"
PREFERRED_VERSION_linux-yocto ?= "3.0%"

PREFERRED_PROVIDER_linux-libc-headers ?= "linux-libc-headers-yocto"
PREFERRED_PROVIDER_virtual/libx11 ?= "libx11-trim"
PREFERRED_PROVIDER_virtual/libgl  ?= "mesa-dri"
PREFERRED_PROVIDER_virtual/xserver ?= "xserver-xf86-dri-lite"
PREFERRED_PROVIDER_virtual/xserver-xf86 ?= "xserver-xf86-dri-lite"
XSERVER ?= "xserver-xf86-dri-lite \
           xf86-input-mouse \
           xf86-input-keyboard \
           xf86-input-evdev \
           xf86-input-synaptics \
           xf86-video-vesa"

SYSLINUX_OPTS = "serial 3 115200"
SERIAL_CONSOLE = "115200 ttyS3"
APPEND += "console=ttyS3,115200 console=tty3"

MACHINE_EXTRA_RRECOMMENDS = "kernel-modules eee-acpi-scripts cedartrail-audio"

IMAGE_FSTYPES ?= "ext3 cpio.gz live"

GLIBC_ADDONS = "nptl"
GLIBC_EXTRA_OECONF = "--with-tls"

MACHINE_ESSENTIAL_EXTRA_RDEPENDS = "grub"
```

## meta-isg/meta-mohonpeak/conf/machine/mohonpeak64.conf
```bitbake
#@TYPE: Machine
#@NAME: mohonpeak 64 bit

#@DESCRIPTION: Machine configuration for Mohon Peak systems

PREFERRED_PROVIDER_virtual/kernel ?= "linux-yocto"
PREFERRED_VERSION_linux-yocto ?= "3.10%"

DEFAULTTUNE ?= "core2-64"

require conf/machine/include/tune-atom.inc
require conf/machine/include/ia32-base.inc
require conf/machine/include/meta-intel.inc

XSERVER ?= "${XSERVER_IA32_BASE} \
	   ${XSERVER_IA32_EXT} \
	   ${XSERVER_IA32_ASPEED_AST} \
	"

MACHINE_FEATURES += "pcbios efi"

SYSLINUX_OPTS = "serial 1 115200"
SERIAL_CONSOLE = "115200 ttyS1"
APPEND += "console=ttyS1,115200 console=tty1"
```

## meta-isg/meta-valleyisland/conf/machine/valleyisland-32.conf
```bitbake
#@TYPE: Machine
#@NAME: valleyisland-32

#@WEBTITLE: Intel Atom E38xx Processor (Valley Island) 32-bit with Open Source Frame Buffer Graphics

#@DESCRIPTION: Machine configuration for Valley Island 32-bit systems, without Intel-proprietary graphics bits

require conf/machine/include/tune-atom.inc
require conf/machine/include/ia32-base.inc

MACHINE_FEATURES += "pcbios efi"

PREFERRED_VERSION_linux-yocto ?= "3.8%"

XSERVER ?= "${XSERVER_IA32_BASE} \
            ${XSERVER_IA32_EXT} \
            ${XSERVER_IA32_FBDEV} \
           "

APPEND += "acpi_enforce_resources=lax video=efifb vga=0x318"
```

## meta-isg/meta-valleyisland/conf/machine/valleyisland-64.conf
```bitbake
#@TYPE: Machine
#@NAME: valleyisland-64

#@WEBTITLE: Intel Atom E38xx Processor (Valley Island) 64-bit with Open Source Frame Buffer Graphics

#@DESCRIPTION: Machine configuration for Valley Island 64-bit systems, without Intel-proprietary graphics bits

DEFAULTTUNE ?= "core2-64"

require conf/machine/include/tune-atom.inc
require conf/machine/include/ia32-base.inc

MACHINE_FEATURES += "pcbios efi"

PREFERRED_VERSION_linux-yocto ?= "3.10%"

XSERVER ?= "${XSERVER_IA32_BASE} \
            ${XSERVER_IA32_EXT} \
	    ${XSERVER_IA32_FBDEV} \
	    ${XSERVER_IA32_I965} \
           "

APPEND += "acpi_enforce_resources=lax video=efifb vga=0x318"
```
